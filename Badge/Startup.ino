/*
 * Startup — the splash at power-on: a picture on the glass and a short sound, then the home
 * screen. Tap the screen or press BOOT to skip.
 *
 * Fifth .ino in the Badge sketch (after Badge, Decider, Gallery, Rumours), so it reuses:
 *   - Decider.ino : decAudioInit(), decI2s, AUD_PA - the 16 kHz I2S + ES8311 audio path;
 *   - Rumours.ino : rumPcm() (frame -> I2S), rumBusy / rumStop / rumoursStop() - the same
 *                   player plumbing, so leaving the splash early stops the sound the same way.
 *
 * Assets: startup_assets.h, generated by tools/prep_startup.py from Downloads\ThanksDanny\startup.
 * The picture is raw RGB565 (no decode: one memcpy + one flush, so it is up within ~50 ms of the
 * panel starting) and the sound is a 16 kHz mono MP3 decoded from flash by the Helix decoder.
 * Both are compiled in so the splash works before Wi-Fi and survives a filesystem reflash.
 */

#include "startup_assets.h"

#define STARTUP_MIN_MS  1800       // the picture stays at least this long, even with no sound
#define STARTUP_MAX_MS  15000      // and never longer than this, whatever the sound does

static const uint8_t *suPtr = nullptr;
static int suLeft = 0;
static uint32_t suShownAt = 0;

// The picture, straight into the canvas and onto the glass.
void showStartupSplash() {
  uint16_t *fb = gfx->getFramebuffer();
  if (!fb) return;
  memcpy(fb, STARTUP_IMG, (size_t)LCD_WIDTH * LCD_HEIGHT * 2);
  gfx->flush();
  suShownAt = millis();
  Serial.println("startup: splash picture up");
}

int suRead(void *ctx, unsigned char *buf, int n) {
  if (rumStop || suLeft <= 0) return 0;
  int k = n < suLeft ? n : suLeft;
  memcpy(buf, suPtr, k);
  suPtr += k;
  suLeft -= k;
  return k;
}

void startupSoundTask(void *arg) {
  uint32_t t0 = millis();
  mp3_result r = mp3_stream(suRead, rumPcm, nullptr);
  static int16_t zeros[512];
  for (int i = 0; i < 6; i++) decI2s.write((uint8_t *)zeros, sizeof(zeros));   // flush with silence
  digitalWrite(AUD_PA, LOW);
  Serial.printf("startup: sound %s - %d frames, %d Hz, %lu ms\n", r.stopped || rumStop ? "skipped" : "done",
                r.frames, r.rate, (unsigned long)(millis() - t0));
  rumLevel = 0;
  rumBusy = false;
  vTaskDelete(nullptr);
}

// Start the sound in the background (core 0). Needs the I2C bus up (touch init does that).
void startupSoundStart() {
  if (STARTUP_MP3_LEN < 4 || !decAudioInit()) return;
  suPtr = STARTUP_MP3;
  suLeft = STARTUP_MP3_LEN;
  rumStop = false;
  rumBusy = true;
  digitalWrite(AUD_PA, HIGH);
  if (xTaskCreatePinnedToCore(startupSoundTask, "startup", 8192, nullptr, 5, nullptr, 0) != pdPASS) {
    rumBusy = false;
    digitalWrite(AUD_PA, LOW);
  }
}

// Hold the splash until the sound has finished (at least STARTUP_MIN_MS). A tap or BOOT skips.
void startupWait() {
  while (true) {
    uint32_t up = millis() - suShownAt;
    if (up >= STARTUP_MAX_MS) break;
    if (!rumBusy && up >= STARTUP_MIN_MS) break;
    int16_t xs[1], ys[1];
    if ((touchOK && touch.getPoint(xs, ys, 1) > 0) || bootButtonHit()) {
      Serial.println("startup: skipped");
      rumoursStop();
      // Do not let the skipping finger become the first tap on the home screen.
      uint32_t t = millis();
      while (millis() - t < 400) {
        if (touchOK && touch.getPoint(xs, ys, 1) > 0) t = millis();
        delay(10);
        if (millis() - suShownAt > STARTUP_MAX_MS + 3000) break;
      }
      break;
    }
    delay(10);
  }
  rumoursStop();
  Serial.printf("startup: splash held %lu ms\n", (unsigned long)(millis() - suShownAt));
}
